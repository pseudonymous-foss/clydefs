## fs/clydefs/Kconfig
```kconfig
config CLYDEFS_FS
	tristate "Clydefs filesystem support"

	help
	  Clydefs is the core tree implementation used in clydefs.

	  Clydefs core is highly experimental. THE DISK FORMAT IS NOT YET FINALIZED.  You should 
	  say N here unless you are interested in testing clydefs with non-critical data.

	  To compile this as a module, choose M here. The
	  module will be called clydefscore.

	  If unsure, say N.

config CLYDEFS_DEBUG
	bool "Clydefs debugging support"
	depends on CLYDEFS_FS
	help
	  Enable run-time debugging support for the clydefs filesystem. This may
	  enable additional and expensive checks with negative impact on
	  performance, or export extra information via sysfs.

	  If unsure, say N.
```

## fs/clydefscore/Kconfig
```kconfig
config CLYDEFS_CORE_FS
	tristate "Clydefs core filesystem support"
	select LIBCRC32C
	select ZLIB_INFLATE
	select ZLIB_DEFLATE
	select LZO_COMPRESS
	select LZO_DECOMPRESS

	help
	  Clydefs core is the core tree implementation used in clydefs.

	  Clydefs core is highly experimental. It requires special hardware that 
	  allows clydefs to pass tree operations toward the block interface.
	  Furthermore, THE DISK FORMAT IS NOT YET FINALIZED.  You should 
	  say N here unless you are interested in testing clydefs with 
	  non-critical data.

	  To compile this as a module, choose M here. The
	  module will be called clydefscore.

	  If unsure, say N.

config CLYDEFS_CORE_DEBUG
	bool "Clydefs core debugging support"
	depends on CLYDEFS_CORE_FS
	help
	  Enable run-time debugging support for the clydefs filesystem. This may
	  enable additional and expensive checks with negative impact on
	  performance, or export extra information via sysfs.

	  If unsure, say N.
```
